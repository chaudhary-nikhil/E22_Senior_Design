## main/Kconfig.projbuild
```kconfig
menu "GoldenForm Firmware"

menu "Hardware Configuration (ESP32-S3-WROOM-1)"

    comment "=== BNO055 IMU (I2C) ==="
    
    config GOLDENFORM_I2C_SDA_GPIO
        int "I2C SDA GPIO"
        range 0 48
        default 4
        help
            I2C data line. Schematic: GPIO 4

    config GOLDENFORM_I2C_SCL_GPIO
        int "I2C SCL GPIO"
        range 0 48
        default 5
        help
            I2C clock line. Schematic: GPIO 5

    config GOLDENFORM_BNO055_ADDR_GPIO
        int "BNO055 address select GPIO"
        range 0 48
        default 6
        help
            Controls BNO055 I2C address (LOW=0x28, HIGH=0x29).
            Schematic: GPIO 6

    config GOLDENFORM_BNO055_INT_GPIO
        int "BNO055 interrupt GPIO (optional)"
        range 0 48
        default 7
        help
            BNO055 interrupt output. Schematic: GPIO 7

    comment "=== SD Card (SPI) ==="

    config GOLDENFORM_SD_MOSI_GPIO
        int "SD MOSI GPIO"
        range 0 48
        default 47
        help
            SPI Master Out Slave In. Schematic: GPIO 47

    config GOLDENFORM_SD_MISO_GPIO
        int "SD MISO GPIO"
        range 0 48
        default 14
        help
            SPI Master In Slave Out. Schematic: GPIO 14

    config GOLDENFORM_SD_SCK_GPIO
        int "SD SCK GPIO"
        range 0 48
        default 21
        help
            SPI clock. Schematic: GPIO 21

    config GOLDENFORM_SD_CS_GPIO
        int "SD CS GPIO"
        range 0 48
        default 48
        help
            SPI chip select. Schematic: GPIO 48

    config GOLDENFORM_SD_DETECT_GPIO
        int "SD card detect GPIO"
        range 0 48
        default 11
        help
            Card detect pin (active low). Schematic: GPIO 11

    comment "=== LEDs ==="

    config GOLDENFORM_LED_1_GPIO
        int "LED 1 GPIO"
        range 0 48
        default 1
        help
            Status LED 1. Schematic: GPIO 1

    config GOLDENFORM_LED_2_GPIO
        int "LED 2 GPIO"
        range 0 48
        default 2
        help
            Status LED 2. Schematic: GPIO 2

    config GOLDENFORM_LED_3_GPIO
        int "LED 3 GPIO"
        range 0 48
        default 8
        help
            Status LED 3. Schematic: GPIO 8

    comment "=== Other ==="

    config GOLDENFORM_HAPTIC_GPIO
        int "Haptic motor GPIO"
        range 0 48
        default 38
        help
            Haptic feedback motor. Schematic: GPIO 38

endmenu

config GOLDENFORM_SAMPLE_HZ
    int "BNO055 sample rate (Hz)"
    range 25 100
    default 50
    help
        BNO055 optimal sample rate for stable sensor fusion

choice
    prompt "IMU sensor"
    default GOLDENFORM_IMU_BNO055
    help
        Select the IMU sensor type
config GOLDENFORM_IMU_BNO055
    bool "BNO055 (9-axis with fusion)"
    help
        Bosch BNO055 with internal sensor fusion
config GOLDENFORM_IMU_MPU6050
    bool "MPU6050 (6-axis)"
    help
        InvenSense MPU6050 6-axis IMU
endchoice

choice
    prompt "Fusion algorithm"
    default GOLDENFORM_FUSION_BNO055_INTERNAL
    help
        Select the orientation fusion algorithm
config GOLDENFORM_FUSION_BNO055_INTERNAL
    bool "BNO055 internal fusion (recommended)"
    depends on GOLDENFORM_IMU_BNO055
config GOLDENFORM_FUSION_MADGWICK
    bool "Madgwick (fast, good default)"
    depends on GOLDENFORM_IMU_MPU6050
config GOLDENFORM_FUSION_MAHONY
    bool "Mahony"
    depends on GOLDENFORM_IMU_MPU6050
endchoice

config GOLDENFORM_ENABLE_BLE
    bool "Enable BLE services (stubs)"
    default n

config GOLDENFORM_ENABLE_STORAGE
    bool "Enable storage (stubs)"
    default n

menu "Storage & PSRAM Configuration"

    config GOLDENFORM_REQUIRE_SD
        bool "Require SD card for recording (PDP)"
        default y
        help
            GoldenForm PDP uses SD for sessions and Wi‑Fi for sync to the dashboard — no UART data path.
            When enabled, the device refuses to enter recording if the SD card is not mounted.
            Disable only for bring-up without an SD socket.

    config PSRAM_BUFFER_CAPACITY_SAMPLES
        int "PSRAM ring buffer capacity (samples)"
        range 1000 100000
        default 47662
        help
            Maximum number of IMU samples to buffer in PSRAM before flushing to SD card.
            Each sample is 88 bytes (bno055_sample_t).
            Default 47662 samples = exactly 4MB (4,194,256 bytes) = ~16 minutes at 50Hz.
            Uses 4MB of the 8MB total PSRAM to leave room for other allocations.
            Larger buffer provides more margin for SD card write latency.

    config PSRAM_BUFFER_WATERMARK_PERCENT
        int "Buffer watermark threshold (%)"
        range 10 90
        default 50
        help
            Trigger SD card flush when buffer reaches this percentage of capacity.
            Lower values flush more frequently (more SD writes, less PSRAM usage).
            Higher values batch more data (fewer SD writes, more PSRAM usage).

    config PSRAM_BUFFER_FLUSH_BATCH_SIZE
        int "Flush batch size (samples)"
        range 64 512
        default 256
        help
            Number of samples to write to SD card in each flush operation.
            Larger batches are more efficient but use more temporary memory.

endmenu

menu "WiFi & Development Options"

    config WIFI_GENERATE_TEST_DATA
        bool "Generate test data when SD card is empty"
        default n
        help
            When enabled, the WiFi sync endpoint will generate fake IMU data
            if no real session data exists on the SD card. This is useful for
            testing WiFi transfer without a real IMU or recording session.
            
            DISABLE THIS FOR PRODUCTION BUILDS - it can mask real data issues.

endmenu

menu "Multi-Device Configuration (Stretch Goal)"

    config GOLDENFORM_DEVICE_ID
        int "Unique device identifier (per physical ESP32)"
        range 0 255
        default 0
        help
            Each wearable must be flashed with a different ID so its Wi‑Fi SSID is unique
            (e.g. GoldenForm_1 vs GoldenForm_2). Use 1, 2, 3… for multi-wearable.
            ID 0 = AP SSID is only "GoldenForm" — do not use for multiple units at once (name clash).

    choice
        prompt "Wearable placement (left or right wrist only)"
        default GOLDENFORM_DEVICE_ROLE_WRIST
        help
            GoldenForm supports two wrist modules (PDP stretch: modular dual-wrist). Flash each ESP32 with a unique DEVICE_ID.
    config GOLDENFORM_DEVICE_ROLE_WRIST
        bool "Right wrist / hand"
    config GOLDENFORM_DEVICE_ROLE_WRIST_LEFT
        bool "Left wrist / hand"
    endchoice

    config GOLDENFORM_DEVICE_NAME
        string "Optional SSID name prefix (before ID)"
        default ""
        help
            Leave empty for SSID GoldenForm_<id> (e.g. GoldenForm_2).
            If set (e.g. W), SSID is GoldenForm_W<id>. Each board still needs its own DEVICE_ID.

    config GOLDENFORM_MULTI_DEVICE_ENABLE
        bool "Enable multi-device synchronization"
        default n
        help
            When enabled, the device broadcasts timing beacons for
            synchronizing data from multiple GoldenForm devices.
            Requires custom multi-device firmware on all devices.
            Leave disabled for single-device operation.

endmenu

endmenu
```

## sdkconfig.defaults
```kconfig
# ESP32-S3-WROOM-1 Configuration
# Optimized settings for ESP32-S3-WROOM-1 module (GoldenForm PCB)

# Target chip
CONFIG_IDF_TARGET="esp32s3"

# Serial flasher config (ESP32-S3-WROOM-1)
CONFIG_ESPTOOLPY_FLASHMODE_QIO=y
CONFIG_ESPTOOLPY_FLASHFREQ_80M=y
CONFIG_ESPTOOLPY_FLASHSIZE_8MB=y

# Partition Table
CONFIG_PARTITION_TABLE_SINGLE_APP=y

# Log output
CONFIG_LOG_DEFAULT_LEVEL_INFO=y
CONFIG_LOG_MAXIMUM_LEVEL_VERBOSE=y

# FreeRTOS
CONFIG_FREERTOS_HZ=1000

# Task Watchdog (give more time for SD card operations)
CONFIG_ESP_TASK_WDT_TIMEOUT_S=10
CONFIG_ESP_TASK_WDT_CHECK_IDLE_TASK_CPU0=n

# UART
CONFIG_UART_ISR_IN_IRAM=y

# Memory (ESP32-S3-WROOM-1 with 8MB Embedded PSRAM)
CONFIG_SPIRAM=y
CONFIG_SPIRAM_MODE_OCT=y
CONFIG_SPIRAM_SPEED_80M=y
CONFIG_SPIRAM_BOOT_INIT=y
CONFIG_SPIRAM_USE_CAPS_ALLOC=y
CONFIG_SPIRAM_MALLOC_ALWAYSINTERNAL=4096
CONFIG_SPIRAM_MALLOC_RESERVE_INTERNAL=32768

# HTTP Server (larger stack for JSON generation)
CONFIG_HTTPD_MAX_REQ_HDR_LEN=1024
CONFIG_HTTPD_MAX_URI_LEN=512

# WiFi (ESP32-S3 has built-in WiFi)
CONFIG_ESP_WIFI_ENABLED=y
CONFIG_ESP_WIFI_STATIC_RX_BUFFER_NUM=10
CONFIG_ESP_WIFI_DYNAMIC_RX_BUFFER_NUM=32
CONFIG_ESP_WIFI_AMPDU_TX_ENABLED=y
CONFIG_ESP_WIFI_AMPDU_RX_ENABLED=y

# Bluetooth (ESP32-S3 supports BLE 5.0)
CONFIG_BT_ENABLED=y
CONFIG_BT_NIMBLE_ENABLED=y

# Power Management
CONFIG_PM_ENABLE=y
CONFIG_PM_DFS_INIT_AUTO=y

# CPU Frequency (ESP32-S3 can run at 240MHz)
CONFIG_ESP_DEFAULT_CPU_FREQ_MHZ_240=y
CONFIG_ESP_DEFAULT_CPU_FREQ_MHZ=240

# USB (ESP32-S3 has native USB - GPIO19/20)
# Keep these free for USB if using USB-OTG
CONFIG_ESP_CONSOLE_UART_DEFAULT=y

# SD card: SPI memory only (no SDIO) — avoids CMD5 and "command not supported" log
CONFIG_SD_ENABLE_SDIO_SUPPORT=n
```
